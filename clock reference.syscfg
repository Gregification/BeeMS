/**
 * @cliArgs --board "/ti/boards/LP_MSPM0G3507" --product "mspm0_sdk@2.05.00.05"
 * @versions {"tool":"1.23.1+4034"}
 */

/**
 * Import the modules used in this configuration.
 */
const I2C    = scripting.addModule("/ti/driverlib/I2C", {}, false);
const I2C1   = I2C.addInstance();
const MCAN   = scripting.addModule("/ti/driverlib/MCAN", {}, false);
const MCAN1  = MCAN.addInstance();
const SPI    = scripting.addModule("/ti/driverlib/SPI", {}, false);
const SPI1   = SPI.addInstance();
const SPI2   = SPI.addInstance();
const SYSCTL = scripting.addModule("/ti/driverlib/SYSCTL");

/**
 * Write custom configuration values to the imported modules.
 */
const divider6       = system.clockTree["PLL_CLK2X_DIV"];
divider6.divideValue = 4;

const divider7       = system.clockTree["PLL_PDIV"];
divider7.divideValue = 2;

const divider9       = system.clockTree["UDIV"];
divider9.divideValue = 2;

const gate7  = system.clockTree["MFCLKGATE"];
gate7.enable = true;

const multiplier2         = system.clockTree["PLL_QDIV"];
multiplier2.multiplyValue = 10;

const mux2       = system.clockTree["CANCLKMUX"];
mux2.inputSelect = "CANCLKMUX_PLLCLK1_OUT";

const mux8       = system.clockTree["HSCLKMUX"];
mux8.inputSelect = "HSCLKMUX_SYSPLL2X";

I2C1.$name                 = "I2C_0";
I2C1.basicEnableController = true;
I2C1.basicClockSource      = "MFCLK";
I2C1.sdaPinConfig.$name    = "ti_driverlib_gpio_GPIOPinGeneric0";
I2C1.sclPinConfig.$name    = "ti_driverlib_gpio_GPIOPinGeneric1";

const Board = scripting.addModule("/ti/driverlib/Board", {}, false);

MCAN1.$name             = "MCAN0";
MCAN1.txPinConfig.$name = "ti_driverlib_gpio_GPIOPinGeneric2";
MCAN1.rxPinConfig.$name = "ti_driverlib_gpio_GPIOPinGeneric3";

SPI1.$name               = "SPI_0";
SPI1.targetBitRate       = 20000000;
SPI1.sclkPinConfig.$name = "ti_driverlib_gpio_GPIOPinGeneric4";
SPI1.mosiPinConfig.$name = "ti_driverlib_gpio_GPIOPinGeneric5";
SPI1.misoPinConfig.$name = "ti_driverlib_gpio_GPIOPinGeneric6";
SPI1.cs0PinConfig.$name  = "ti_driverlib_gpio_GPIOPinGeneric7";

SPI2.$name               = "SPI_1";
SPI2.sclkPinConfig.$name = "ti_driverlib_gpio_GPIOPinGeneric8";
SPI2.mosiPinConfig.$name = "ti_driverlib_gpio_GPIOPinGeneric9";
SPI2.misoPinConfig.$name = "ti_driverlib_gpio_GPIOPinGeneric10";
SPI2.cs0PinConfig.$name  = "ti_driverlib_gpio_GPIOPinGeneric11";

SYSCTL.clockTreeEn = true;

/**
 * Pinmux solution for unlocked pins/peripherals. This ensures that minor changes to the automatic solver in a future
 * version of the tool will not impact the pinmux you originally saw.  These lines can be completely deleted in order to
 * re-solve from scratch.
 */
I2C1.peripheral.$suggestSolution           = "I2C1";
I2C1.peripheral.sdaPin.$suggestSolution    = "j17_expansion.2";
I2C1.peripheral.sclPin.$suggestSolution    = "boosterpack.30";
Board.peripheral.$suggestSolution          = "DEBUGSS";
Board.peripheral.swclkPin.$suggestSolution = "j25_expansion.16";
Board.peripheral.swdioPin.$suggestSolution = "j25_expansion.14";
MCAN1.peripheral.$suggestSolution          = "CANFD0";
MCAN1.peripheral.rxPin.$suggestSolution    = "boosterpack.31";
MCAN1.peripheral.txPin.$suggestSolution    = "boosterpack.32";
SPI1.peripheral.$suggestSolution           = "SPI1";
SPI1.peripheral.sclkPin.$suggestSolution   = "boosterpack.28";
SPI1.peripheral.mosiPin.$suggestSolution   = "boosterpack.26";
SPI1.peripheral.misoPin.$suggestSolution   = "boosterpack.29";
SPI1.peripheral.cs0Pin.$suggestSolution    = "boosterpack.5";
SPI2.peripheral.$suggestSolution           = "SPI0";
SPI2.peripheral.sclkPin.$suggestSolution   = "boosterpack.33";
SPI2.peripheral.mosiPin.$suggestSolution   = "j17_expansion.7";
SPI2.peripheral.misoPin.$suggestSolution   = "boosterpack.34";
SPI2.peripheral.cs0Pin.$suggestSolution    = "j17_expansion.1";
